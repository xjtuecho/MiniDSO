/******************** (C) COPYRIGHT 2014 e-Design Co.,Ltd. *********************
 File Name : Draw.c
 Version   : DS202 Ver 1.0                                       Author : bure
*******************************************************************************/
#include <string.h>
#include "Draw.h"
#include "Bios.h"
#include "LCD.h"
#include "Func.h"
#include "Menu.h"

extern u8 APP_VERSION[];

uc16  Mark_TAB[] ={    
  0x000,0x000,0x042,0x0FE,0x002,0x000,0x101,    // Mark 1
  0x000,0x046,0x08A,0x092,0x092,0x062,0x101,    // Mark 2
  0x000,0x044,0x082,0x092,0x092,0x06C,0x101,    // Mark 3
  0x000,0x040,0x040,0x07E,0x040,0x040,0x101};   // Mark T

uc16 SYMB8x14[]={  // 显示符号图形数据定义
  0x0000,0x0000,0x0000,0x0C60,0x0C60,0x0000,0x0000,0x0000, // @ :
  0x0FC0,0x0840,0x7878,0x4008,0x4008,0x4008,0x4008,0x4008, // A 空电池头
  0x4008,0x4008,0x4008,0x4008,0x4008,0x4008,0x4008,0x4008, // B 空电池身
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  0xFFFF,0xE7FF,0xE7FF,0xE01F,0xE01F,0xE7FF,0xE7FF,0xFFFF, // m  T
};

uc16 CHAR8x14[]={
  0x0000,0x0000,0x1C00,0x3F60,0x3F60,0x1C00,0x0000,0x0000, // !  
  0x0000,0x7000,0x7800,0x0000,0x0000,0x0000,0x7800,0x7000, // "  
  0x0000,0x0880,0x3FE0,0x3FE0,0x0880,0x3FE0,0x3FE0,0x0880, // #  
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  0x0000,0x01C0,0x03C0,0x0640,0x0C40,0x0640,0x03C0,0x01C0};// tri

uc16 CHAR6x8[] = { 
  0x00,0x00,0xFA,0xFA,0x00,0x00, 	//!
  0x00,0x00,0xE0,0x00,0xE0,0x00, 	//"  
  0x00,0x28,0xFE,0x28,0xFE,0x28, 	//#  
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  0x00,0x30,0x60,0x30,0x18,0x30,        //~  
};

uc16 SYMB6x8[] = { 
  0x00,0x00,0xFA,0xFA,0x00,0x00, 	//!
  0x18,0x38,0x38,0x10,0x10,0x30,        //" usb左
  0x50,0x90,0x98,0xD4,0xD2,0x12,        //# usb中
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  0x01,0x63,0x3E,0x1C,0x00,0x00,        //~ 关机右  
};

// 显示缓冲区 VRAM = CCM = 0x10000000~0x10001FFF 8KB
u16* ParamTab = (u16*)(CCM_ADDR+TAB_PTR); // 显示变量参数表

// View 窗口中的显示变量参数表初始化数据
//+=============+======+======+======+======+======+======+======+======+======+
//   主窗标志   |  W1F |  W2F |  W3F |  VTF |  V1F |  V2F |  T0F |  T1F |  T2F |  
//+-------------+------+------+------+------+------+------+------+------+------+
uc16 PARAM[] =  { L_HID, L_HID, L_HID,  SHOW,  SHOW,  SHOW,  SHOW,  SHOW,  SHOW,
//+=============+======+======+======+======+======+======+======+======+======+
//   主窗变量   | P1x2 | P2x2 | P3x2 | VTx2 | V1x2 | V2x2 | T0x1 | T1x1 | T2x1 | 
//+-------------+------+------+------+------+------+------+------+------+------+
                   320,   160,    60,   220,   350,   50,   125,    50,   225,
//+=============+======+======+======+======+======+======+======+======+======+
//   主窗颜色   |  W1C |  W2C |  W3C |  VTC |  V1C |  V2C |  T0C |  T1C |  T2C | 
//+-------------+------+------+------+------+------+------+------+------+------+
                   CYN,   YEL,   PUR,   CYN,   WHT,   WHT,   ORN,   WHT,   WHT,
//+=============+======+======+======+======+======+======+======+======+======+
//   主窗副色   | W1C_ | W2C_ | W3C_ |      |      | 
//+-------------+------+------+------+------+------+------+------+------+------+
                  CYN_,  YEL_,  PUR_, 
//+=============+======+======+======+======+======+======+======+======+======+
//   主窗变量   | M_X0 | M_Y0 | M_WX |      |      |      |      |      |      |
//+-------------+------+------+------+------+------+------+------+------+------+
                    7,    20,   251,    
//+=============+======+======+======+======+======+======+======+======+======+
//   子窗变量   | POPF | BXx1 | WXx1 | BYx2 | HYx2 |      |      |      |      |
//+-------------+------+------+------+------+------+------+------+------+------+
                  P_HID,  180,   100,    26,   256,
//+=============+======+======+======+======+======+======+======+======+======+
//  子窗调色板  | CN=2   CN=4   CN=6   CN=8  CN=10  CN=12  CN=14                 
//+-------------+------+------+------+------+------+------+------+------+------+
                  CYN,   YEL,   PUR,   GRN,   ORN,   WHT,   DAR,              };
//+=============+======+======+======+======+======+======+======+======+======+


static u16 Nx = 5,   Ny = 5;   // 弹出窗当前显示位置
static s16 Dx = 1,   Dy = 2;
static u8  Pop_B_Cn, Pop_F_Cn; // 弹出窗当前显示色号

u8  PopType  = DEMO_POP;
u16 Sx = 0, Sy = 0;            // 主屏幕当前显示位置
u16 Background, Foreground;    // 主屏幕当前显示颜色

/*******************************************************************************
 PopColor: 弹出窗颜色设置
*******************************************************************************/
void PopColor(u16 Board_Color, u16 Text_Color)
{
  u8 i;
  for(i=14; i>0; i-=2) if(Board_Color == ParamTab[POP_CN-1+i/2]) break;
  Pop_B_Cn = i;
  for(i=14; i>0; i-=2) if(Text_Color  == ParamTab[POP_CN-1+i/2]) break;
  Pop_F_Cn = i;
}
/*******************************************************************************
 SetColor: LCD屏幕颜色设置
*******************************************************************************/
void SetColor(u16 Board_Color, u16 Text_Color)
{
  Background = Board_Color;
  Foreground = Text_Color;
}
/*******************************************************************************
 PopPixel: 弹出窗像素设置     Color: 像素颜色(1/0)  像素定位: Nx, Ny
*******************************************************************************/
void PopPixel(u8 ColorNum)
{
  u8  *PopBuf = (u8*)CCM_ADDR+POP_BUF;

  Nx = Nx%ParamTab[PWx1]; Ny = Ny%ParamTab[PHx2]; // Nx, Ny 超界则返回起点
  u16 i  = Nx*ParamTab[PHx2]/4+ Ny/2;
  if(Ny++%2) PopBuf[i] = (PopBuf[i]&0x0F)|(ColorNum << 4);
  else       PopBuf[i] = (PopBuf[i]&0xF0)| ColorNum;
}
/*******************************************************************************
  OpenPop: 画弹出窗外框及清除弹出窗内容  输入参数: PopX, PopY, PopH, PopW, Mod
*******************************************************************************/
void OpenPop(u8 PopX, u8 PopY, u8 PopH, u8 PopW, u8 Mode)
{
  u16 i, Transpa = 0;
  u8  *PopBuf = (u8*)CCM_ADDR+POP_BUF;

  if(PopH > 180) PopH = 180;
  if(PopW > 240) PopW = 240;
  if(PopH*PopW > POP_SIZE*2) PopW = POP_SIZE*2/PopH;

  ParamTab[PXx1] = PopX; ParamTab[PYx2] = 2*PopY;
  ParamTab[PWx1] = PopW; ParamTab[PHx2] = 2*PopH;
  if(Mode == COVER) memset(PopBuf, Pop_B_Cn+(Pop_B_Cn<<4), POP_SIZE);
  else              memset(PopBuf, Transpa +(Transpa <<4), POP_SIZE);

  Nx = 0; Ny = 0;
  PopPixel(Transpa); PopPixel(Transpa); PopPixel(Transpa);
  for(i=0; i<ParamTab[PHx2]/2-6; i++) PopPixel(Pop_F_Cn);
  PopPixel(Transpa); PopPixel(Transpa); PopPixel(Transpa);

  Nx = 1; Ny = 0;
  PopPixel(Transpa);  PopPixel(Transpa); PopPixel(Pop_F_Cn);
  Ny = ParamTab[PHx2]/2 -3;
  PopPixel(Pop_F_Cn); PopPixel(Transpa); PopPixel(Transpa);

  Nx = 2;Ny = 0;            PopPixel(Transpa);  PopPixel(Pop_F_Cn);
  Ny = ParamTab[PHx2]/2 -2; PopPixel(Pop_F_Cn); PopPixel(Transpa);

  for(Nx=3; Nx<ParamTab[PWx1]-2; Nx++){
    Ny = 0;                   PopPixel(Pop_F_Cn);
    Ny = ParamTab[PHx2]/2 -1; PopPixel(Pop_F_Cn);
  }
  Nx = ParamTab[PWx1]-3; Ny = 0;
  PopPixel(Transpa);  PopPixel(Pop_F_Cn);
  Nx = ParamTab[PWx1]-3; Ny = ParamTab[PHx2]/2 -2;
  PopPixel(Pop_F_Cn); PopPixel(Transpa);

  Nx = ParamTab[PWx1]-2; Ny = 0;
  PopPixel(Transpa);  PopPixel(Transpa); PopPixel(Pop_F_Cn);
  Nx = ParamTab[PWx1]-2; Ny = ParamTab[PHx2]/2 -3;
  PopPixel(Pop_F_Cn); PopPixel(Transpa); PopPixel(Transpa);

  Nx = ParamTab[PWx1]-1; Ny = 0;
  PopPixel(Transpa); PopPixel(Transpa); PopPixel(Transpa);

  for(i=0; i<ParamTab[PHx2]/2-6; i++) PopPixel(Pop_F_Cn);
  PopPixel(Transpa); PopPixel(Transpa); PopPixel(Transpa);
}
/*******************************************************************************
 PopChar: 弹出窗内显示字符/图块       Mode = bit0: Normal/Inv, bit1: Char/Symb
*******************************************************************************/
void PopChar(u8 Mode, u8 Code)
{
  u16 i, j, k;

  for(i=0; i<8; ++i){
    if(Mode & SYMB) k = SYMB8x14[(Code - '@')*8 + i];
    else            k = __Font_8x14(Code, i); 
    if(Mode & VOID) k &= (i%2)? 0xAAAA : 0x5555;
    for(j=0; j<14; ++j){
      if(k & 4)  PopPixel((Mode & INV)? Pop_B_Cn : Pop_F_Cn);
      else       PopPixel((Mode & INV)? Pop_F_Cn : Pop_B_Cn);
      k >>= 1;
    }
    Nx++; Ny -= 14;
  }
}
/*******************************************************************************
 PopChar6x8: 弹出窗内显示字符/图块     Mode = bit0: Normal/Inv, bit1: Char/Symb
*******************************************************************************/
void PopChar6x8(u8 Mode, u8 Code)
{
  u16 i, j, k;

  for(i=0; i<6; ++i){
    if(Mode & SYMB) k = SYMB6x8[(Code - '!')*6 + i];
    else            k = Get_TAB_6x8(Code, i); 
    if(Mode & VOID) k &= (i%2)? 0xAAAA : 0x5555;
    PopPixel((Mode & INV)? Pop_F_Cn : Pop_B_Cn);
    Ny = Ny+1;
    for(j=0; j<10; ++j){
      if(k & 1)  PopPixel((Mode & INV)? Pop_B_Cn : Pop_F_Cn);
      else       PopPixel((Mode & INV)? Pop_F_Cn : Pop_B_Cn);
      k >>= 1;
    }
    Nx++; Ny -= 11;
  }
}
/*******************************************************************************
 NoteSTR: 弹出窗内显示字符/图块串      Mode = bit0: Normal/Inv, bit1: Char/Symb
*******************************************************************************/
void Pop_STR(u16 Nx0, u16 Ny0, u8 Mode, u8 *Str)
{
  u8 i;
  Nx = Nx0, Ny = Ny0;
  for (i=0; i<14; i++) PopPixel((Mode & INV)? Pop_F_Cn : Pop_B_Cn);
  Nx++,     Ny = Ny0;                           
  while(*Str != 0){
    PopChar(Mode, *Str++);
  }
}
/*******************************************************************************
 NoteSTR86x8: 弹出窗内显示字符/图块串   Mode = bit0: Normal/Inv, bit1: Char/Symb
*******************************************************************************/
void Pop_STR6x8(u16 Nx0, u16 Ny0, u8 Mode, u8 *Str)
{
  u16 i, j, k;
  u8 Code;
  Nx = Nx0, Ny = Ny0;
  
  while(*Str != 0){
    Code = *Str++;
    for(i=0; i<6; ++i){
      if(Mode & SYMB) k = SYMB6x8[(Code - '!')*6 + i];
      else            k = Get_TAB_6x8(Code, i); 
      if(Mode & VOID) k &= (i%2)? 0xAAAA : 0x5555;
      PopPixel((Mode & INV)? Pop_F_Cn : Pop_B_Cn);
      Ny = Ny0+1;
      for(j=0; j<10; ++j){
        if(k & 1)  PopPixel((Mode & INV)? Pop_B_Cn : Pop_F_Cn);
        else       PopPixel((Mode & INV)? Pop_F_Cn : Pop_B_Cn);
        k >>= 1;
      }
      Nx++; Ny -= 11;
    }
  }
}
/*******************************************************************************
 Disp_Char: 主屏幕显示字符/图块         Mode = bit0: Normal/Inv, bit1: Char/Map
*******************************************************************************/
void DispChar(u8 Mode, u8 Code)
{
  u16 i, j, k;
  
  for(i=0; i<8; ++i){
    if(Mode & SYMB) k = SYMB8x14[(Code - '@')*8 + i];
    else            k = Get_TAB_8x14(Code, i);
    if(Mode & VOID) k &= (i%2)? 0xAAAA : 0x5555;
    SetPosi(Sx, Sy);
    if((Mode & SYMB)&&(Code == 'a' || Code=='b')){       //AC/DC标志显示
      for(j=0; j<11; ++j){
        if(k & 4)  SetPixel((Mode & INV)? Background : Foreground);
        else       SetPixel((Mode & INV)? Foreground : Background);
        k >>= 1;}
    }
    else if((Mode & SYMB)&&(Code == 'L' || Code=='H')){ //上升沿，下降沿
      SetPosi(Sx, Sy);
      for(j=0; j<11; ++j){
        if(k & 4)  SetPixel((Mode & INV)? Background : Foreground);
        else       SetPixel((Mode & INV)? Foreground : Background);
        k >>= 1;
      }
    }
    else{
      for(j=0; j<14; ++j){
        if(k & 4)  SetPixel((Mode & INV)? Background : Foreground);
        else       SetPixel((Mode & INV)? Foreground : Background);
        k >>= 1;
      }
    }
    Sx++;
  }
  
}
/*******************************************************************************
 Disp_Char8x9: 主屏幕显示字符/图块       Mode = bit0: Normal/Inv, bit1: Char/Map
*******************************************************************************/
void DispChar8x9(u8 Mode, u8 Code)
{
  u16 i, j, k;
  
  for(i=0; i<8; ++i){
    if(Mode & SYMB) k = SYMB8x14[(Code - '@')*8 + i];
    else            k = Get_TAB_8x9(Code, i);
    if(Mode & VOID) k &= (i%2)? 0xAAAA : 0x5555;
    SetPosi(Sx, Sy);
    if((Mode & SYMB)&&(Code == 'a' || Code=='b')){      //AC/DC标志显示
      for(j=0; j<10; ++j){
        if(k & 4)  SetPixel((Mode & INV)? Background : Foreground);
        else       SetPixel((Mode & INV)? Foreground : Background);
        k >>= 1;}
    }
    else if((Mode & SYMB)&&(Code == 'c' || Code=='d')){ //X1、X10标志显示
      SetPosi(Sx, Sy+9);
      for(j=0; j<5; ++j){
        if(k & 4)  SetPixel((Mode & INV)? Background : Foreground);
        else       SetPixel((Mode & INV)? Foreground : Background);
        k >>= 1;
      }
    }
    else{
      for(j=0; j<9; ++j){
        if(k & 1)  SetPixel((Mode & INV)? Background : Foreground);
        else       SetPixel((Mode & INV)? Foreground : Background);
        k >>= 1;
      }
    }
    Sx++;
  }
  
}
/*******************************************************************************
  DispStr: 主屏幕显示字符/图块串        Mode = bit0: Normal/Inv, bit1: Char/Map
*******************************************************************************/
void DispStr(u16 x0, u16 y0, u8 Mode, u8 *Str)
{
  Sx = x0; Sy = y0;                              
  while(*Str != 0){
    DispChar(Mode, *Str++);
  }
}
/*******************************************************************************
  DispStr8x9: 主屏幕显示字符/图块串      Mode = bit0: Normal/Inv, bit1: Char/Map
*******************************************************************************/
void DispStr8x9(u16 x0, u16 y0, u8 Mode, u8 *Str)
{
  u16 i ;
  Sx = x0; Sy = y0;
  __SetPosi(Sx, Sy);
  for (i=0; i<9; i++) __SetPixel((Mode & INV)? Foreground : Background);
  Sx++;                                   // 每一个字符串前增加一空白列
  while(*Str != 0){
    DispChar8x9(Mode, *Str++);
  }
}
/*******************************************************************************
  List_Pop: 打开菜单窗
*******************************************************************************/
void List_Pop(void)
{
  PopType |= LIST_POP;
  ParamTab[POPF] = SHOW;
}
/*******************************************************************************
  Close_Pop: 关闭菜单窗及会话窗
*******************************************************************************/
void ClosePop(void)
{
  PopType &= ~(LIST_POP | DAILOG_POP | FILE_POP );
  if(!(PopType & DEMO_POP)) ParamTab[POPF] = P_HID;
  else Demo_Pop();
}
/*******************************************************************************
  Move_Pop: 打开及游动演示窗
*******************************************************************************/
void MovePop(void)
{
  if(menu.menu_flag){
   if((ParamTab[PXx1]<= 3)||((ParamTab[PXx1]+ParamTab[PWx1])>= (WIDTH_MINI+1))) 
     Dx = -Dx;
  }else if((ParamTab[PXx1]<= 3)||((ParamTab[PXx1]+ParamTab[PWx1])>= (WIDTH+1)))
     Dx = -Dx;
  ParamTab[PXx1] += Dx;
  if((ParamTab[PYx2]<= 6)||((ParamTab[PYx2]+ParamTab[PHx2])>= 402)) Dy = -Dy;
  ParamTab[PYx2] += Dy;
  ParamTab[POPF] = SHOW;
}
/*******************************************************************************
  Dialog_Pop: 弹出会话窗
*******************************************************************************/
void Dialog_Pop(u8* Str)
{
  PopType |= LIST_POP;
  PopColor(WHT, DAR);
  OpenPop(125, 50, 32, 20*6, COVER);
  Pop_STR6x8( 1*6, 16, PRN, Str);
  Pop_STR6x8( 2*6, 4,  SYMB,  "[\\");
  Pop_STR6x8( 4*6, 4,  PRN,  ":Yes");
  Pop_STR6x8(11*6, 4,  SYMB,  "()");
  Pop_STR6x8(13*6, 4,  PRN,  ":No");
  ParamTab[POPF] = SHOW;
}
/*******************************************************************************
  Power_Pop: 弹出会话窗
*******************************************************************************/
void Power_Pop(u8* Str, u16 X_Posi, u16 Y_Posi, u16 High, u16 Width )
{
  PopType |= PWR_POP;
  PopColor(DAR,WHT);
  OpenPop(X_Posi, Y_Posi, High, Width, COVER);
  Pop_STR6x8( 4*6, 41, PRN, Str);
  Pop_STR6x8( 1*6, 29, SYMB,  "{|:");         //播放暂停图标
  Pop_STR6x8( 5*6, 29, PRN,  "PwrOff Only");
  Pop_STR6x8( 1*6, 17, SYMB,   "[\\:");       //"S" 
  Pop_STR6x8( 5*6, 17, PRN,   "PwrOff & SaveParam");
  Pop_STR6x8( 1*6, 5,  SYMB,  "}~:");         //关机图标
  Pop_STR6x8( 5*6, 5,  PRN,  "Exit");
  ParamTab[POPF] = SHOW;
}
/*******************************************************************************
  Dialog_Pop_Cal: 弹出会话窗
*******************************************************************************/
void Dialog_CalPop(u8* Str, u16 X_Posi, u16 Y_Posi, u16 High, u16 Width )
{
  u16 i;
  i = (Width - 17*6)/2;                      //选择按钮行起始位置
  PopType |= DAILOG_POP;
  PopColor(WHT,DAR);
  OpenPop(X_Posi, Y_Posi, High, Width, COVER);
  Pop_STR6x8( 1*6, 16, PRN, Str);
  Pop_STR6x8( i,      4, SYMB,  "[\\");      //关机图标
  Pop_STR6x8( i+ 2*6, 4, PRN,  ":Yes");
  Pop_STR6x8( i+10*6, 4, SYMB,  "()");       //播放暂停图标
  Pop_STR6x8( i+12*6, 4, PRN,  ":No");
  ParamTab[POPF] = SHOW;
}
/*******************************************************************************
  Product_Pop: 弹出会话窗
*******************************************************************************/
void Product_Pop(u8* Str, u16 X_Posi, u16 Y_Posi, u16 High, u16 Width )
{
  u16 i;
  u8 ptr[15];
  i = Width/5;                               //标题起始位置
  PopType |= DAILOG_POP;
  PopColor(DAR,WHT);
  OpenPop(X_Posi, Y_Posi, High, Width, COVER);
  PopColor(DAR,WHT);
  Pop_STR6x8( i, 83, PRN, Str);
  Word2Hex(ptr, __Info(DEV_SN));
  Pop_STR6x8( 4,        70, PRN, "DeviceSN: ");
  Pop_STR6x8( 4+10*6,   70, PRN,  ptr);
  Pop_STR6x8( 4,        59, PRN, "Hardware: Ver ");
  Pop_STR6x8( 4+14*6,   59, PRN,  (u8*)__Info(SCH));
  Pop_STR6x8( 4,        48, PRN, "MCU Type: ");
  Pop_STR6x8( 4+10*6,   48, PRN,  (u8*)__Info(MCU));
  Pop_STR6x8( 4,        37, PRN, "LCD Type: ");
  Pop_STR6x8( 4+10*6,   37, PRN,  (u8*)__Info(LCD));
  Pop_STR6x8( 4,        26, PRN, "USB Disk: ");
  Pop_STR6x8( 4+10*6,   26, PRN,  (u8*)__Info(DISK));
  Pop_STR6x8( 4,        15, PRN, "DFU Type: ");
  Pop_STR6x8( 4+10*6,   15, PRN,  (u8*)__Info(DFU));
  Pop_STR6x8( 4,        4,  PRN, "APP Type: ");
  Pop_STR6x8( 4+10*6,   4,  PRN,  APP_VERSION); 
  ParamTab[POPF] = SHOW;
}
/*******************************************************************************
  About_Pop: 弹出会话窗
*******************************************************************************/
void About_Pop(u8* Str, u16 X_Posi, u16 Y_Posi, u16 High, u16 Width )
{ 
  PopType |= DAILOG_POP;
  PopColor(WHT,DAR);
  OpenPop(X_Posi, Y_Posi, High, Width, COVER);
  Pop_STR6x8( 1*6, 4, PRN, Str);
  ParamTab[POPF] = SHOW;
}
/*******************************************************************************
  显示关机提示弹出窗
*******************************************************************************/
void PwrOff_Pop(void)
{
  PopType |= PWR_POP;
  PopColor(DAR, WHT);
  OpenPop(50, 100, 3*8, 26*6, COVER);
  Pop_STR6x8( 1*8, 6, PRN, "Hold on into power off");
  ParamTab[POPF] = SHOW;
}
/*******************************************************************************
  提示弹出窗
*******************************************************************************/
void Tips_Pop(u8* Str)
{
  PopType |= DAILOG_POP;
  PopColor(WHT, DAR);
  OpenPop(40, 110, 24, 29*6, COVER);
  Pop_STR6x8( 1*8, 6, PRN, Str);
  ParamTab[POPF] = SHOW;
}
/*******************************************************************************
  显示Demo_Pop提示弹出窗
*******************************************************************************/
void Demo_Pop(void)
{
  PopColor(BLK, WHT);
  PopType = DEMO_POP;
  OpenPop(10, 10, 48, 41, TRNSI);    //COVER
  PopColor(BLK, CYN);
  Pop_STR(4, 26, INV, "Demo");
  PopColor(BLK, ORN);
  Pop_STR(4, 10, PRN, "only");
}
/*******************************************************************************
  打印字符串
*******************************************************************************/
void PrintStr(u8 Mode, u8 *Str)
{
  u16 i, j, k;

  SetPosi(Sx, Sy);
  for (i=0; i<14; i++) SetPixel((Mode & INV)? Foreground : Background);
  Sx++;                             // 每一个字符串前增加一空白列
  while(*Str != 0){
    for(i=0; i<8; ++i){
      if(!(Mode & SYMB)) k = Get_TAB_8x14(*Str, i);
      else               k = SYMB8x14[(*Str - '@')*8 + i];
      if(Mode & VOID) k &= (i%2)? 0xAAAA : 0x5555;
      SetPosi(Sx, Sy);
      for(j=0; j<14; ++j){
        if(k & 8)  SetPixel((Mode & INV)? Background : Foreground);
        else       SetPixel((Mode & INV)? Foreground : Background);
       k >>= 1;
      }
      Sx++;                        //显示位置水平方向+1
    }
    Str++;                         //字符串指针+1
  }
}
/*******************************************************************************
  打印字符串6x8
*******************************************************************************/
void PrintStr6x8(u8 Mode, u8 *Str)
{
  u8 Code;
  u16 i, j, k;
  
  SetPosi(Sx, Sy);
  while(*Str != 0){
    Code = *Str++;
    for(i=0; i<6; ++i){
      if(!(Mode & SYMB)) k = Get_TAB_6x8(Code, i);
      else               k = SYMB6x8[(Code - '!')*6 + i];
      if(Mode & VOID) k &= (i%2)? 0xAAAA : 0x5555;
      SetPosi(Sx, Sy);  SetPixel((Mode & INV)? Foreground : Background);
      SetPosi(Sx, Sy+1);
      for(j=0; j<10; ++j){  //j<8时不空行，j<10空两行   即上下各空两行
        if(k & 1)  SetPixel((Mode & INV)? Background : Foreground);
        else       SetPixel((Mode & INV)? Foreground : Background);
       k >>= 1;
      }
      Sx++;                 //显示位置水平方向+1
    }
  }
}
/*******************************************************************************
  Label打印字符串
*******************************************************************************/
void PrintStr_Cur(u8 Mode, u8 *Str)
{
  u16 i, j, k;

  SetPosi(Sx, Sy);
  while(*Str != 0){
    for(i=0; i<7; ++i){

      k = Mark_TAB[(*Str - '1')*7+i];
      if(Mode & VOID) k &= (i%2)? 0xAAAA : 0x5555;
      SetPosi(Sx, Sy);
      for(j=0; j<9; ++j){
        if(k & 1)  SetPixel((Mode & INV)? Foreground : Background);
        else       SetPixel((Mode & INV)? Background : Foreground);
       k >>= 1;
      }
      Sx++;               //显示位置水平方向+1
    }
    Str++;                //字符串指针+1
  }
}

/*******************************************************************************
 Display_Str: 在指定位置显示字符串   输入: X、Y坐标，颜色值，字符串
*******************************************************************************/
u16 Get_TAB_6x8(u8 Code, u16 Row)
{
  if((Code < 0x21)||(Code > 0x7E))  return 0;
  else if(Row < 6) return CHAR6x8[((Code-0X21)*6)+Row];
  else             return 0;
}

void DispStr6x8(u16 x0, u16 y0, u8 Mode, u8 *Str)
{
  Sx = x0; Sy = y0;
  __SetPosi(Sx, Sy);
  
  while(*Str != 0){
    DispChar6x8(Mode, *Str++);
  }
}
/*******************************************************************************
 Disp_Char6x8: 主屏幕显示字符/图块       Mode = bit0: Normal/Inv, bit1: Char/Map
*******************************************************************************/
void DispChar6x8(u8 Mode, u8 Code)
{
  u16 i, j, k;
  
  for(i=0; i<6; ++i){
    if(Mode & SYMB) k = SYMB6x8[(Code - '!')*6 + i];
    else            k = Get_TAB_6x8(Code, i);
    if(Mode & VOID) k &= (i%2)? 0xAAAA : 0x5555;
    SetPosi(Sx, Sy);
    if((Mode & SYMB)&&(Code == 'a' || Code=='b')){     //AC/DC标志显示
      for(j=0; j<10; ++j){
        if(k & 4)  SetPixel((Mode & INV)? Background : Foreground);
        else       SetPixel((Mode & INV)? Foreground : Background);
        k >>= 1;}
    }
    else if((Mode & SYMB)&&(Code == 'c' || Code=='d')){ //X1、X10标志显示
     SetPosi(Sx, Sy+9);
      for(j=0; j<5; ++j){
        if(k & 4)  SetPixel((Mode & INV)? Background : Foreground);
        else       SetPixel((Mode & INV)? Foreground : Background);
        k >>= 1;
      }
    }
    else{
      SetPosi(Sx, Sy);  SetPixel((Mode & INV)? Foreground : Background);
      SetPosi(Sx, Sy+1);
      for(j=0; j<10; ++j){
        if(k & 1)  SetPixel((Mode & INV)? Background : Foreground);
        else       SetPixel((Mode & INV)? Foreground : Background);
        k >>= 1;
      }
    }
    Sx++;
  }  
}

/*******************************************************************************
 viod Clr_WaveWin(u16 Col)  清除波形显示区
*******************************************************************************/
void Clr_WaveWin(u16 Col)
{
  u16 x,y,i,j;
  x = 7;
  y = 20;
  for(i=0;i<254;i++){
    __SetPosi(x++, y);
    for(j=0;j<203;j++){
      __SetPixel(Col);
    }
  }
}
/*******************************************************************************
 viod Clr_WavePosi(u16 Col)  清除波形位置显示
*******************************************************************************/
void Clr_WavePosi(u16 Col)
{
  u16 x,y,i,j;
  x=10;
  y=14;
  for(i=0;i<250;i++){
    SetPosi(x++, y);
    for(j=0; j<6; j++)SetPixel(Col);
  } 
}


/******************************** END OF FILE *********************************/
