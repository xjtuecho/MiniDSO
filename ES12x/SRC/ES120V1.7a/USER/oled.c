/********************* (C) COPYRIGHT 2016 e-Design Co.,Ltd. ********************
File Name :      olde.c
Version :        1.7a
Description:
Author :         Ning
Data:            2017/11/22
History:
2017/06/20       新增不同硬件版本下的定义配置;
2017/10/21       优化汇总iic配置;    
*******************************************************************************/
#include <stdio.h>
#include <string.h>
#include "Oled.h"
#include "HARDWARE.h"
#include "Delay.h"
#include "iic.h"
/*******************************************************************************
函数名: Set_ShowPos
函数作用:要显示内容的位置
输入参数:x:横坐标,y:纵坐标(0,8,16,24)
返回参数:NULL
*******************************************************************************/
void OLED_Set_Pos(u8 x, u8 y)
{
    x +=0;
    Write_IIC_Command(0xb0+y);
    Write_IIC_Command(((x&0xf0)>>4)|0x10);
    Write_IIC_Command(x&0x0f);//Write_IIC_Command((x&0x0f)|0x01);
}
/*******************************************************************************
函数名: Oled_DrawArea
函数作用:显示一个区域
输入参数: x0:起始横坐标
          y0:起始纵坐标(0,8,16,24)
          wide:显示内容宽度
          high:显示内容高度
          ptr:显示的内容库指针
返回参数:下一库指针
*******************************************************************************/
u8* Oled_DrawArea(u8 x0,u8 y0,u8 wide, u8 high,u8 *ptr)
{
    u8 m,n,y,x;
    
    n = y0 + high;
    if(y0 % 8 == 0) m = y0 / 8;
    else            m = y0 / 8 + 1;

    if(n % 8 == 0)  y = n / 8;
    else            y = n / 8 + 1;
    
    //y是有多少行.
    //m是多少个8行,每多一个m值加一.
    for(; m < y; m++) {
        OLED_Set_Pos(x0,m);
        for(x=0; x<wide; x++) {
            Write_IIC_Data(*ptr++);
        }
    }
    return ptr;
}

/*******************************************************************************
函数名: Init_Oled
函数作用:初始化LED设置
输入参数:NULL
返回参数:NULL
*******************************************************************************/
void Init_Oled(void)
{
    OLED_RST();
    Delay_Ms(2);
    OLED_ACT();
    Delay_Ms(2);
    
    Delay_Ms(105);

    Write_IIC_Command(0xAE);       //Display OFF (sleep mode) 
    Write_IIC_Command(0xD5);       //Set Display Clock Divide Ratio/Oscillator Frequency
    Write_IIC_Command(0x52);       //parem
    Write_IIC_Command(0xA8);       //Set Multiplex Ratio 
    Write_IIC_Command(0x0f);       //0x0f A[5:0]
    Write_IIC_Command(0xC8);       //Set COM Output Scan Direction  0xC0 
    Write_IIC_Command(0xD3);       //Set Display Offset 
    Write_IIC_Command(0x00); 
    Write_IIC_Command(0x40);       //Set Display Start Line 0x40
    Write_IIC_Command(0xA1);       //Set Segment Re-map 0xA0
    Write_IIC_Command(0x8D);       //Set Display Offset 
    Write_IIC_Command(0x14);       //VCC Generated by Internal DC/DC circuit 调亮度 0x14
    Write_IIC_Command(0xDA);       //Set COM Pins Hardware Configuration 
    Write_IIC_Command(0x02);       //0x02
    Write_IIC_Command(0x81);       //Set Contrast Control 
    Write_IIC_Command(0xe0);       //对比度（1-256)//0x56 0xe0
    Write_IIC_Command(0xD9);       //Set Pre-charge Period 
    Write_IIC_Command(0xf1);       //VCC Supplied Externally 0xf1
    Write_IIC_Command(0xDB);       //Set VCOMH Deselect Level (带1个参数）
    Write_IIC_Command(0x30);       //0,0x20,0x30
    Write_IIC_Command(0xA4);       //Output follows RAM content 
    Write_IIC_Command(0xA6);       //Set Normal Display 
    Write_IIC_Command(0xAF);       //Set Display ON (normal mode) 
}


/******************************** END OF FILE *********************************/
